## meta-myattestation/conf/layer.conf
```bitbake
# meta-myattestation layer configuration

BBPATH .= ":${LAYERDIR}"

BBFILES += "${LAYERDIR}/recipes-*/*/*.bb \
            ${LAYERDIR}/recipes-*/*/*.bbappend"

BBFILE_COLLECTIONS += "myattestation"
BBFILE_PATTERN_myattestation = "^${LAYERDIR}/"
BBFILE_PRIORITY_myattestation = "6"

LAYERSERIES_COMPAT_myattestation = "scarthgap styhead walnascar whinlatter"
```
